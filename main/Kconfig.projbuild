## main/Kconfig.projbuild
```kconfig
menu "Project Configuration"

    menu "HID (BLE Mouse)"
        # Garante que o componente NimBLE HID Service seja habilitado.
        # Nao aparece como opcao selecionavel porque so existe um role (mouse).
        config EXAMPLE_MOUSE_ENABLE
            bool
            depends on BT_NIMBLE_ENABLED
            select BT_NIMBLE_HID_SERVICE
            default y
    endmenu

    menu "MPU6050 (I2C)"
        choice EXAMPLE_MPU6050_I2C_ADDRESS
            prompt "Select I2C address"
            default EXAMPLE_MPU6050_I2C_ADDRESS_LOW
            help
                Endereco I2C do MPU6050. Depende do nivel do pino AD0 do sensor.

            config EXAMPLE_MPU6050_I2C_ADDRESS_LOW
                bool "MPU6050_I2C_ADDRESS_LOW (0x68)"
                help
                    Escolha esta opcao quando o pino AD0 estiver ligado ao GND.

            config EXAMPLE_MPU6050_I2C_ADDRESS_HIGH
                bool "MPU6050_I2C_ADDRESS_HIGH (0x69)"
                help
                    Escolha esta opcao quando o pino AD0 estiver ligado ao VCC.
        endchoice

        config EXAMPLE_MPU6050_SCL_GPIO
            int "MPU6050 SCL GPIO Number"
            # Evita GPIO4/5 (ja usados pelo SPI slave) e GPIO9 (strapping pin de boot)
            default 1
            help
                GPIO usado para a linha SCL (clock) do I2C do MPU6050.
                Na ESP32-C3 SuperMini, evite GPIO2/8/9 (strapping pins),
                GPIO18/19 (USB) e GPIO20/21 (UART0/log), e qualquer pino
                ja usado pelo barramento SPI.

        config EXAMPLE_MPU6050_SDA_GPIO
            int "MPU6050 SDA GPIO Number"
            default 0
            help
                GPIO usado para a linha SDA (dados) do I2C do MPU6050.
                Mesmas restricoes do SCL acima.
    endmenu

endmenu
```
